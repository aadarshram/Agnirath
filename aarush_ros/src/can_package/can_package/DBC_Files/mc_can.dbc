VERSION "0.0"

NS_ :

BS_:

BU_:

BO_ 1024 Identification: 8 Vector__XXX
	SG_ Prohelion_ID : 0|32@1+ (1,0) [0|0] "" Vector__XXX
	SG_ Serial_Number : 32|32@1+ (1,0) [0|0] "" Vector__XXX

BO_ 1025 Status: 8 Vector__XXX
	SG_ Output_Voltage_PWM_Limit : 0|1@1+ (1,0) [0|0] "" Vector__XXX
	SG_ Motor_Current_Limit : 1|1@1+ (1,0) [0|0] "" Vector__XXX
	SG_ Velocity_Limit : 2|1@1+ (1,0) [0|0] "" Vector__XXX
	SG_ Bus_Current_Limit : 3|1@1+ (1,0) [0|0] "" Vector__XXX
	SG_ Bus_Voltage_U_Limit : 4|1@1+ (1,0) [0|0] "" Vector__XXX
	SG_ Bus_Voltage_L_Limit : 5|1@1+ (1,0) [0|0] "" Vector__XXX
	SG_ Motor_Temperature_Limit : 6|1@1+ (1,0) [0|0] "" Vector__XXX
	SG_ Hardware_Over_Current : 16|1@1+ (1,0) [0|0] "" Vector__XXX
	SG_ Software_Over_Current : 17|1@1+ (1,0) [0|0] "" Vector__XXX
	SG_ Bus_Overvoltage : 18|1@1+ (1,0) [0|0] "" Vector__XXX
	SG_ Bad_Hall_Sequence : 19|1@1+ (1,0) [0|0] "" Vector__XXX
	SG_ Watchdog_Reset : 20|1@1+ (1,0) [0|0] "" Vector__XXX
	SG_ Config_Read_Error : 21|1@1+ (1,0) [0|0] "" Vector__XXX
	SG_ UVLO_15V : 22|1@1+ (1,0) [0|0] "" Vector__XXX
	SG_ Desaturation_Fault : 23|1@1+ (1,0) [0|0] "" Vector__XXX
	SG_ Motor_Over_Speed : 24|1@1+ (1,0) [0|0] "" Vector__XXX
	SG_ Active_Motor : 32|16@1+ (1,0) [0|0] "" Vector__XXX
	SG_ Transmit_Error_Count : 48|8@1+ (1,0) [0|0] "" Vector__XXX
	SG_ Receive_Error_Count : 56|8@1+ (1,0) [0|0] "" Vector__XXX

BO_ 1026 Bus_Measurement: 8 Vector__XXX
	SG_ Bus_Voltage : 0|32@1+ (1,0) [0|0] "Volt" Vector__XXX
	SG_ Bus_Current : 32|32@1+ (1,0) [0|0] "Ampere" Vector__XXX

BO_ 1027 Velocity: 8 Vector__XXX
	SG_ Motor_Velocity : 0|32@1+ (1,0) [0|0] "RMP" Vector__XXX
	SG_ Vehicle_Velocity : 32|32@1+ (1,0) [0|0] "m/s" Vector__XXX

BO_ 1028 Phase_Current: 8 Vector__XXX
	SG_ PhaseC_Current_Val : 32|32@1+ (1,0) [0|0] "Ampere" Vector__XXX
	SG_ PhaseB_Current_Val : 0|32@1+ (1,0) [0|0] "Ampere" Vector__XXX

BO_ 1029 Motor_Voltage_Vector: 8 Vector__XXX
	SG_ Vq : 0|32@1+ (1,0) [0|0] "Volt" Vector__XXX
	SG_ Vd : 32|32@1+ (1,0) [0|0] "Volt" Vector__XXX

BO_ 1030 Motor_Current_Vector: 8 Vector__XXX
	SG_ Iq : 0|32@1+ (1,0) [0|0] "Ampere" Vector__XXX
	SG_ Id : 32|32@1+ (1,0) [0|0] "Ampere" Vector__XXX

BO_ 1031 BackEMF: 8 Vector__XXX
	SG_ BEMFq : 0|32@1+ (1,0) [0|0] "Volt" Vector__XXX
	SG_ BEMFd : 32|32@1+ (1,0) [0|0] "Volt" Vector__XXX

BO_ 1032 Voltage_Rail_15V: 8 Vector__XXX
	SG_ Supply_15V : 32|32@1+ (1,0) [0|0] "Volt" Vector__XXX

BO_ 1033 Voltage_Rail_3V3_1V9: 8 Vector__XXX
	SG_ Supply_1V9 : 0|32@1+ (1,0) [0|0] "" Vector__XXX
	SG_ Supply_3V3 : 32|32@1+ (1,0) [0|0] "" Vector__XXX

BO_ 1035 HeatSink_Motor_Temperature: 8 Vector__XXX
	SG_ Motor_Temp : 0|32@1+ (1,0) [0|0] "Celcius" Vector__XXX
	SG_ Heat_Sink_Temp : 32|32@1+ (1,0) [0|0] "Celcius" Vector__XXX

BO_ 1036 DSP_Temperature: 8 Vector__XXX
	SG_ DSP_Board_Temperature : 0|32@1+ (1,0) [0|0] "Celcius" Vector__XXX

BO_ 1038 Odometer_Charge: 8 Vector__XXX
	SG_ Odometer : 0|32@1+ (1,0) [0|0] "meter" Vector__XXX
	SG_ DC_Bus_AmpHours : 32|32@1+ (1,0) [0|0] "Ah" Vector__XXX

BO_ 1047 Slip_Speed: 8 Vector__XXX
	SG_ Slip_Speed : 32|32@1+ (1,0) [0|0] "Hz" Vector__XXX

BO_ 1042 Active_Motor_Change: 8 Vector__XXX
	SG_ Config_Key : 0|32@1+ (1,0) [0|0] "" Vector__XXX
	SG_ Active_Motor : 32|32@1+ (1,0) [0|0] "" Vector__XXX

BA_DEF_  "BusType" STRING ;
BA_DEF_DEF_  "BusType" "";
BA_ "BusType" "CAN";

SIG_VALTYPE_ 1026 Bus_Voltage : 1;
SIG_VALTYPE_ 1026 Bus_Current : 1;
SIG_VALTYPE_ 1027 Motor_Velocity : 1;
SIG_VALTYPE_ 1027 Vehicle_Velocity : 1;
SIG_VALTYPE_ 1028 PhaseC_Current_Val : 1;
SIG_VALTYPE_ 1028 PhaseB_Current_Val : 1;
SIG_VALTYPE_ 1029 Vq : 1;
SIG_VALTYPE_ 1029 Vd : 1;
SIG_VALTYPE_ 1030 Iq : 1;
SIG_VALTYPE_ 1030 Id : 1;
SIG_VALTYPE_ 1031 BEMFq : 1;
SIG_VALTYPE_ 1031 BEMFd : 1;
SIG_VALTYPE_ 1032 Supply_15V : 1;
SIG_VALTYPE_ 1033 Supply_1V9 : 1;
SIG_VALTYPE_ 1033 Supply_3V3 : 1;
SIG_VALTYPE_ 1035 Motor_Temp : 1;
SIG_VALTYPE_ 1035 Heat_Sink_Temp : 1;
SIG_VALTYPE_ 1036 DSP_Board_Temperature : 1;
SIG_VALTYPE_ 1038 Odometer : 1;
SIG_VALTYPE_ 1038 DC_Bus_AmpHours : 1;
SIG_VALTYPE_ 1047 Slip_Speed : 1;
